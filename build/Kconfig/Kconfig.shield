## build/Kconfig/Kconfig.shield
```kconfig
osource "c:/users/marco/ncs/v1.9.1/zephyr/boards/arm/boards/shields/*/Kconfig.shield"
osource "C:/ncs/v2.2.0/nrf/boards/shields/*/Kconfig.shield"
```

## build/Kconfig/Kconfig.shield.defconfig
```kconfig
osource "c:/users/marco/ncs/v1.9.1/zephyr/boards/arm/boards/shields/*/Kconfig.defconfig"
osource "C:/ncs/v2.2.0/nrf/boards/shields/*/Kconfig.defconfig"
```
